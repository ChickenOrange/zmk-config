## boards/shields/trackball_v1/Kconfig.defconfig
```kconfig
if SHIELD_TRACKBALL_V1

# Name must be less than 16 characters long!
config ZMK_TRACKBALL_V1
    default "trackball_v1"
    
# Other keyboard settings

config ZMK_POINTING
    default y

# Assuming pointing device uses SPI
config SPI
    default y

endif
```

## boards/shields/trackball_v1/Kconfig.shield
```kconfig
# No whitespace after the comma or in your keyboard name!
config SHIELD_TRACKBALL_V1
    def_bool $(shields_list_contains,trackball_v1)
    CONFIG_SPI=y
    CONFIG_INPUT=y
    CONFIG_ZMK_POINTING=y
    CONFIG_PMW3610=y
    # CONFIG_PMW3610_SWAP_XY=y // <-- deprecated, use swap-xy; instead
    # CONFIG_PMW3610_INVERT_X=y // <-- deprecated, use invert-x; instead
    # CONFIG_PMW3610_INVERT_Y=y // <-- deprecated, use invert-y; instead
    # CONFIG_PMW3610_REPORT_INTERVAL_MIN=12
    # CONFIG_PMW3610_LOG_LEVEL_DBG=y
    # CONFIG_PMW3610_INIT_POWER_UP_EXTRA_DELAY_MS=300 // <--see Troubleshooting
```

## config/west.yml
```yaml
manifest:
  defaults:
    revision: v0.3
  remotes:
    - name: zmkfirmware
      url-base: https://github.com/zmkfirmware
      #PMW 3610 driver
    - name: badjeff
      url-base: https://github.com/badjeff
    # Additional modules containing boards/shields/custom code can be listed here as well
    # See https://docs.zephyrproject.org/3.2.0/develop/west/manifest.html#projects
  projects:
    - name: zmk
      remote: zmkfirmware
      import: app/west.yml
      #PMW 3610 driver
    - name: zmk-pmw3610-driver
      remote: badjeff
      revision: main
  self:
    path: config
```
